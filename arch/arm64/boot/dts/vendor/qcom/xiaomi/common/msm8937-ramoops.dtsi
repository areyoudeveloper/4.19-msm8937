&reserved_memory {
	ramoops@b0000000 {
			compatible = "ramoops";
			reg = <0 0xb0000000 0 0x400000>;
			record-size = <0x200000>;
			console-size = <0x200000>;
	};
};

&soc {
	restart@4ab000 {
		qcom,force-warm-reboot;
	};
};
